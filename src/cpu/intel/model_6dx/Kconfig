## src/cpu/intel/model_6dx/Kconfig
```kconfig
## SPDX-License-Identifier: GPL-2.0-only

config CPU_INTEL_MODEL_6DX
	bool
	select ARCH_X86
	select SSE2
	select SUPPORT_CPU_UCODE_IN_CBFS
```

## src/mainboard/apple/i945_macs/Kconfig
```kconfig
## SPDX-License-Identifier: GPL-2.0-only

config BOARD_APPLE_I945_MACS_COMMON
	bool
	select CPU_INTEL_SOCKET_M
	select NORTHBRIDGE_INTEL_I945
	select NORTHBRIDGE_INTEL_SUBTYPE_I945GM
	select SOUTHBRIDGE_INTEL_I82801GX
	select NO_UART_ON_SUPERIO
	select EC_ACPI
	select HAVE_OPTION_TABLE
	select HAVE_CMOS_DEFAULT
	select HAVE_MP_TABLE
	select BOARD_ROMSIZE_KB_2048
	select INTEL_INT15
	select HAVE_ACPI_TABLES
	select HAVE_ACPI_RESUME

config BOARD_APPLE_MACBOOK11
	bool
	select BOARD_APPLE_I945_MACS_COMMON
	select SYSTEM_TYPE_LAPTOP

config BOARD_APPLE_MACBOOK21
	bool
	select BOARD_APPLE_I945_MACS_COMMON
	select SYSTEM_TYPE_LAPTOP

config BOARD_APPLE_IMAC41
	bool
	select BOARD_APPLE_I945_MACS_COMMON
#	select VGA_BIOS

config BOARD_APPLE_IMAC52
	bool
	select BOARD_APPLE_I945_MACS_COMMON

config BOARD_APPLE_ATV1
	bool
	select BOARD_APPLE_I945_MACS_COMMON

# The ATV1 firmware leaves the ICH7 GPIO block at 0x500 and the PM block
# at 0x400.  Preserve both windows: the GPIO block is the handshake to the
# board's power/thermal MCU and must not be relocated.
config SOUTHBRIDGE_INTEL_I82801GX_GPIOBASE
	default 0x500 if BOARD_APPLE_ATV1

config SOUTHBRIDGE_INTEL_I82801GX_PMBASE
	default 0x400 if BOARD_APPLE_ATV1

if BOARD_APPLE_I945_MACS_COMMON

config MAINBOARD_DIR
	default "apple/i945_macs"

config MAINBOARD_PART_NUMBER
	default "Macbook1,1" if BOARD_APPLE_MACBOOK11
	default "MacBook2,1" if BOARD_APPLE_MACBOOK21
	default "iMac4,1" if BOARD_APPLE_IMAC41
	default "iMac5,2" if BOARD_APPLE_IMAC52
	default "AppleTV1,1" if BOARD_APPLE_ATV1

config VARIANT_DIR
	default "macbook1_1" if BOARD_APPLE_MACBOOK11
	default "macbook2_1" if BOARD_APPLE_MACBOOK21
	default "imac4_1" if BOARD_APPLE_IMAC41
	default "imac5_2" if BOARD_APPLE_IMAC52
	default "atv1" if BOARD_APPLE_ATV1

config OVERRIDE_DEVICETREE
	default "variants/\$(CONFIG_VARIANT_DIR)/overridetree.cb"

config MAX_CPUS
	default 2

config MAINBOARD_SMBIOS_MANUFACTURER
	default "Apple Inc."

endif

if BOARD_APPLE_IMAC41

config VGA_BIOS_ID
	string
	default "1002,71c5"

endif
```
